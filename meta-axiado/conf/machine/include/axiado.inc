## meta-axiado/conf/machine/include/axiado.inc
```bitbake
# Copyright (c) 2021-22 Axiado Corporation (or its affiliates). All rights reserved.
# Use, modification and redistribution of this file is subject to your possession
# of a valid End User License Agreement (EULA) for the Axiado Product of which
# these sources are part of and your compliance with all applicable terms and
# conditions of such licence agreement.

SOC_FAMILY = "axiado-ax3000"
include conf/machine/include/soc-family.inc
include conf/machine/include/arm/arch-arm64.inc

PREFERRED_PROVIDER_virtual/kernel ?= "linux-axiado"
PREFERRED_PROVIDER_virtual/bootloader ?= "u-boot-axiado"
PREFERRED_PROVIDER_u-boot ?= "u-boot-axiado"

KERNEL_IMAGETYPE ?= "Image"
INITRAMFS_IMAGE = "obmc-phosphor-initramfs"
INITRAMFS_FSTYPES = "cpio.xz"
IMAGE_FSTYPES = "${INITRAMFS_FSTYPES} wic.xz mmc-ext4-tar"
INITRAMFS_IMAGE_BUNDLE = "1"
IMAGE_CLASSES:append = " image_types_ax3000"

DEFAULTTUNE:ax3000 ?= "aarch64"
 
WKS_FILE ?= "emmc-axiado.wks.in"
WKS_FILE_DEPENDS ?= "virtual/kernel"
WKS_FILE_DEPENDS += "e2fsprogs-native"

FLASH_KERNEL_IMAGE ?= "Image"
```

## meta-axiado/meta-ax3000/conf/layer.conf
```bitbake
# We have a conf and classes directory, add to BBPATH
BBPATH .= ":${LAYERDIR}"

# We have recipes-* directories, add to BBFILES
BBFILES += "${LAYERDIR}/recipes-*/*/*.bb \
            ${LAYERDIR}/recipes-*/*/*.bbappend"

BBFILE_COLLECTIONS += "meta-ax3000"
BBFILE_PATTERN_meta-ax3000 = "^${LAYERDIR}/"

LAYERDEPENDS_meta-ax3000 = "core"
LAYERSERIES_COMPAT_meta-ax3000 = "kirkstone langdale"
```

## meta-axiado/meta-ax3000/conf/machine/ax3000.conf
```bitbake
# Copyright (c) 2021-22 Axiado Corporation (or its affiliates). All rights reserved.
# Use, modification and redistribution of this file is subject to your possession
# of a valid End User License Agreement (EULA) for the Axiado Product of which
# these sources are part of and your compliance with all applicable terms and
# conditions of such licence agreement.

KMACHINE = "ax3000"
KERNEL_DEVICETREE = "axiado/${KMACHINE}-evk.dtb"

PREFERRED_PROVIDER_u-boot = "u-boot-axiado"
PREFERRED_PROVIDER_virtual/bootloader = "u-boot-axiado"
 
UBOOT_MACHINE = "ax3000_evk_defconfig"

require conf/machine/include/axiado.inc
require conf/machine/include/ax3000.inc
require conf/distro/include/phosphor-mmc.inc

FLASH_SIZE = "32768"
SERIAL_CONSOLES = "115200;ttyPS3"
OBMC_ORG_YAML_SUBDIRS:append:ax3000 = " com/axiado"

OBMC_IMAGE_EXTRA_INSTALL:append = " python3 python3-flask"
INITRAMFS_MAXSIZE = "431072"
OBMC_COMPATIBLE_NAMES = "ax3000"
EXTENDED_VERSION = "${DISTRO_VERSION}"
RDEPENDS:${PN}-devtools:remove = "trace-enable"
```

## meta-axiado/meta-ax3000/conf/machine/include/ax3000.inc
```bitbake
# Copyright (c) 2021-22 Axiado Corporation (or its affiliates). All rights reserved.
# Use, modification and redistribution of this file is subject to your possession
# of a valid End User License Agreement (EULA) for the Axiado Product of which
# these sources are part of and your compliance with all applicable terms and
# conditions of such licence agreement.

MACHINE_FEATURES += "\
        obmc-bmc-state-mgmt \
        obmc-chassis-state-mgmt \
        obmc-host-ipmi \
        obmc-host-state-mgmt \
        obmc-phosphor-chassis-mgmt \
        obmc-phosphor-fan-mgmt \
        obmc-phosphor-flash-mgmt \
        "

VIRTUAL-RUNTIME_skeleton_workbook = "${MACHINE}-config"

PREFERRED_PROVIDER_virtual/obmc-chassis-mgmt = "packagegroup-ax3000-apps"
PREFERRED_PROVIDER_virtual/obmc-fan-mgmt = "packagegroup-ax3000-apps"
PREFERRED_PROVIDER_virtual/obmc-flash-mgmt = "packagegroup-ax3000-apps"
PREFERRED_PROVIDER_virtual/obmc-inventory-data ?= "${VIRTUAL-RUNTIME_skeleton_workbook}"
PREFERRED_PROVIDER_virtual/obmc-system-mgmt = "packagegroup-ax3000-apps"

VIRTUAL-RUNTIME_obmc-host-state-manager ?= "x86-power-control"
VIRTUAL-RUNTIME_obmc-chassis-state-manager ?= "x86-power-control"

PREFERRED_PROVIDER_virtual/obmc-host-ipmi-hw ?= "phosphor-ipmi-kcs"

IMAGE_FEATURES:remove = "obmc-settings-mgmt \
			 obmc-inventory \
			 obmc-leds \
			 obmc-net-ipmi \
			 obmc-network-mgmt \
			 obmc-fru-ipmi \
			 obmc-fan-control \
			 obmc-fan-mgmt \
			 obmc-host-state-mgmt \
			 obmc-chassis-mgmt \
			 obmc-chassis-state-mgmt \
			 "
IMAGE_FEATURES:append = " allow-root-login"

# We don't need any legacy sysv rc compatability
PACKAGECONFIG:remove = "sysvinit"

# We don't enable kernel modules
PACKAGECONFIG:remove = "kmod"
```
